ENTRY(_start)

/* 1. Explicitly define the hardware permission groups */
PHDRS
{
    text    PT_LOAD    FLAGS((1 << 0) | (1 << 2)) ; /* Execute + Read */
    rodata  PT_LOAD    FLAGS((1 << 2)) ;            /* Read only */
    data    PT_LOAD    FLAGS((1 << 1) | (1 << 2)) ; /* Write + Read */
}

SECTIONS {
    . = 0xffffffff80000000;

    /* Assign executable code to the 'text' group */
    .text : {
        *(.text .text.*)
    } :text

    /* Force page alignment */
    . = ALIGN(4K);

    /* Assign read-only data to the 'rodata' group */
    .rodata : {
        KEEP(*(.requests))
        *(.rodata .rodata.*)
    } :rodata

    /* Force page alignment */
    . = ALIGN(4K);

    /* Assign mutable data to the 'data' group */
    .data : {
        *(.data .data.*)

        /* CATCH THE STRAY SECTIONS GENERATED BY `alloc`! */
        *(.data.rel.ro .data.rel.ro.*)
        *(.got .got.*)
    } :data

    /* .bss shares the 'data' permissions, so it doesn't need a 4K alignment gap */
    .bss : {
        *(COMMON)
        *(.bss .bss.*)
    } :data

    /DISCARD/ : {
        *(.eh_frame)
        *(.note .note.*)
    }
}